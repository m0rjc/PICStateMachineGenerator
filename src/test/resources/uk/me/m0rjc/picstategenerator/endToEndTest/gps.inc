;------------------------------------------------------------------------------
; This file was auto-generated by PICStateGenerator. Do not edit.
; Generated: Tue Nov 15 22:27:57 GMT 2011
;------------------------------------------------------------------------------
#ifndef _GPS_H_
#define _GPS_H_

;------------------------------------------------------------------------------
; Initialisation method.
; Call before first use.
;------------------------------------------------------------------------------
              EXTERN   gpsInit

;------------------------------------------------------------------------------
; Step method.
; Call to advance state machine after setting input.
;------------------------------------------------------------------------------
              EXTERN   gpsStep
              EXTERN   gpsLatitudeDegMin
              EXTERN   gpsFlags
              EXTERN   gpsLongitudeHundredths
              EXTERN   gpsTime
              EXTERN   testSendVar
              EXTERN   gpsLongitudeDegMin
              EXTERN   gpsQuality
              EXTERN   testSendIndex
              EXTERN   gpsLatitudeHundredths
              EXTERN   gpsInput


;------------------------------------------------------------------------------
; Access Variables
;------------------------------------------------------------------------------
              EXTERN   gpsFlags
#define NEW_POSITION (0)
#define NORTH (1)
#define EAST (2)
#define TEST_PLEASE_SEND (3)
#define Test4 (4)
#define Test5 (5)
#define Test6 (6)
#define Test7 (7)
#define Test8 (0)
#define Test9 (1)
              EXTERN   gpsInput


;------------------------------------------------------------------------------
; Variables for bank gpsBank1
;------------------------------------------------------------------------------
              EXTERN   gpsLatitudeDegMin
              EXTERN   gpsLongitudeHundredths
              EXTERN   gpsTime
              EXTERN   testSendVar
              EXTERN   gpsLongitudeDegMin
              EXTERN   gpsQuality
              EXTERN   testSendIndex
              EXTERN   gpsLatitudeHundredths

#endif
